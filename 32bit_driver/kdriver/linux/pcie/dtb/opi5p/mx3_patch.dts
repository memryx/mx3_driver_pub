/dts-v1/;
/plugin/;

/ {
	fragment@0 {
		target-path = "/pcie@fe150000";
		__overlay__ {
			#address-cells = <0x03>;
			#size-cells = <0x02>;
			ranges = <0x81000000 0x00 0xf0100000 0x00 0xf0100000 0x00 0x100000 0x82000000 0x00 0x40000000 0x09 0x00000000 0x00 0x18000000>;
		};
	};
};
